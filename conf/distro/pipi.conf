## conf/distro/pipi.conf
```bitbake
DISTRO = "pipi"
DISTRO_NAME = "PiPi distribution"
DISTRO_VERSION = "0.1"
MAINTAINER = "Pascal Linder <pascallinder@bluewin.ch>"

TCLIBC = "glibc"
TCLIBCAPPEND = ""

INIT_MANAGER = "systemd"
PACKAGE_CLASSES = "package_ipk"

DISTRO_FEATURES:append = " security"

require conf/distro/include/security_flags.inc
```

## conf/layer.conf
```bitbake
BBPATH .= ":${LAYERDIR}"

BBFILES += "${LAYERDIR}/recipes-*/*/*.bb ${LAYERDIR}/recipes-*/*/*.bbappend"

BBFILE_COLLECTIONS += "pipi"
BBFILE_PATTERN_pipi := "^${LAYERDIR}/"
BBFILE_PRIORITY_pipi = "10"

LAYERDEPENDS_pipi = ""
LAYERSERIES_COMPAT_pipi = "kirkstone"
```
